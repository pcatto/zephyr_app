## boards/nucleo_g431rb.conf
```kconfig
# Misc
CONFIG_HEAP_MEM_POOL_SIZE=8192
CONFIG_SHELL_STACK_SIZE=4096

# Enable Shell
CONFIG_SHELL=y

# Setting the Shell prompt
CONFIG_SHELL_PROMPT_UART="~ "

# Setting the max argc
CONFIG_SHELL_ARGC_MAX=12

# Enable the Zephyr boot banner
CONFIG_BOOT_BANNER=y

# Enable GPIO
CONFIG_GPIO=y

# enable runtime status
CONFIG_THREAD_RUNTIME_STATS=y
```
